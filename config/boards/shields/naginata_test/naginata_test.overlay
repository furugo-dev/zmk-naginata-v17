/*
 * 薙刀式モジュールのコンパイル確認用テストシールド
 * nice_nano_v2 (nRF52840) + GPIO direct kscan 31キー
 */

/ {
    chosen {
        zmk,kscan = &kscan0;
    };

    kscan0: kscan {
        compatible = "zmk,kscan-gpio-direct";
        input-gpios
            /* 上段: Q W E R T Y U I O P */
            = <&gpio0  6 (GPIO_ACTIVE_LOW | GPIO_PULL_UP)>
            , <&gpio0  8 (GPIO_ACTIVE_LOW | GPIO_PULL_UP)>
            , <&gpio0  9 (GPIO_ACTIVE_LOW | GPIO_PULL_UP)>
            , <&gpio0 10 (GPIO_ACTIVE_LOW | GPIO_PULL_UP)>
            , <&gpio0 11 (GPIO_ACTIVE_LOW | GPIO_PULL_UP)>
            , <&gpio0 12 (GPIO_ACTIVE_LOW | GPIO_PULL_UP)>
            , <&gpio0 13 (GPIO_ACTIVE_LOW | GPIO_PULL_UP)>
            , <&gpio0 15 (GPIO_ACTIVE_LOW | GPIO_PULL_UP)>
            , <&gpio0 16 (GPIO_ACTIVE_LOW | GPIO_PULL_UP)>
            , <&gpio0 17 (GPIO_ACTIVE_LOW | GPIO_PULL_UP)>
            /* 中段: A S D F G H J K L ; */
            , <&gpio0 19 (GPIO_ACTIVE_LOW | GPIO_PULL_UP)>
            , <&gpio0 20 (GPIO_ACTIVE_LOW | GPIO_PULL_UP)>
            , <&gpio0 21 (GPIO_ACTIVE_LOW | GPIO_PULL_UP)>
            , <&gpio0 22 (GPIO_ACTIVE_LOW | GPIO_PULL_UP)>
            , <&gpio0 24 (GPIO_ACTIVE_LOW | GPIO_PULL_UP)>
            , <&gpio1  0 (GPIO_ACTIVE_LOW | GPIO_PULL_UP)>
            , <&gpio1  1 (GPIO_ACTIVE_LOW | GPIO_PULL_UP)>
            , <&gpio1  2 (GPIO_ACTIVE_LOW | GPIO_PULL_UP)>
            , <&gpio1  3 (GPIO_ACTIVE_LOW | GPIO_PULL_UP)>
            , <&gpio1  4 (GPIO_ACTIVE_LOW | GPIO_PULL_UP)>
            /* 下段: Z X C V B N M , . / */
            , <&gpio1  5 (GPIO_ACTIVE_LOW | GPIO_PULL_UP)>
            , <&gpio1  6 (GPIO_ACTIVE_LOW | GPIO_PULL_UP)>
            , <&gpio1  7 (GPIO_ACTIVE_LOW | GPIO_PULL_UP)>
            , <&gpio1  8 (GPIO_ACTIVE_LOW | GPIO_PULL_UP)>
            , <&gpio1  9 (GPIO_ACTIVE_LOW | GPIO_PULL_UP)>
            , <&gpio1 10 (GPIO_ACTIVE_LOW | GPIO_PULL_UP)>
            , <&gpio1 11 (GPIO_ACTIVE_LOW | GPIO_PULL_UP)>
            , <&gpio1 12 (GPIO_ACTIVE_LOW | GPIO_PULL_UP)>
            , <&gpio1 13 (GPIO_ACTIVE_LOW | GPIO_PULL_UP)>
            , <&gpio1 14 (GPIO_ACTIVE_LOW | GPIO_PULL_UP)>
            /* 親指: Space */
            , <&gpio1 15 (GPIO_ACTIVE_LOW | GPIO_PULL_UP)>
            ;
    };
};
