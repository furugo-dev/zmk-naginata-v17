/*
 * Copyright (c) 2020 The ZMK Contributors
 *
 * SPDX-License-Identifier: MIT
 */

/ {
    behaviors {
        /omit-if-no-ref/ ng: naginata {
            compatible = "zmk,behavior-naginata";
            #binding-cells = <1>;
        };
    };
};
